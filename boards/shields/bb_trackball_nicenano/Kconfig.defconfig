## boards/shields/bb_trackball_nicenano/Kconfig.defconfig
```kconfig
# Kconfig.defconfig — auto-applied defaults when SHIELD_BB_TRACKBALL is selected

if SHIELD_BB_TRACKBALL

# Set the keyboard name that appears over BLE/USB HID
config ZMK_KEYBOARD_NAME
    default "BB Trackball Keyboard"

# Enable ZMK pointing/mouse HID support
config ZMK_POINTING
    default y

# Enable the analog input driver (badjeff's module)
config ANALOG_INPUT
    default y

# GPIO support (needed for hall-sensor interrupt lines)
config GPIO
    default y

endif # SHIELD_BB_TRACKBALL
```

## boards/shields/bb_trackball_nicenano/Kconfig.shield
```kconfig
# Copyright (c) 2022 The ZMK Contributors
# SPDX-License-Identifier: MIT

config SHIELD_BB_TRACKBALL_NICENANO
    def_bool $(shields_list_contains,bb_trackball_nicenano)
```

## config/west.yml
```yaml
manifest:
  remotes:
    - name: zmkfirmware
      url-base: https://github.com/zmkfirmware
    # badjeff's analog input driver — used to decode the trackball's
    # quadrature hall-effect signals as pointer X/Y events.
    - name: badjeff
      url-base: https://github.com/badjeff

  projects:
    - name: zmk
      remote: zmkfirmware
      revision: main
      import: app/west.yml

    # ZMK Analog Input Driver
    # Lets you group GPIO/ADC channels into a single input event for the
    # ZMK input subsystem. We use this to convert the four BB trackball
    # hall-sensor lines into pointer X/Y deltas.
    - name: zmk-analog-input-driver
      remote: badjeff
      revision: main

  self:
    path: config
```
